## chapter-5/5.3/Kconfig
```kconfig
config BUDDY_TEST
tristate "Test buddy system"
default m
help
   Allocate pages from buddy system.
```

## chapter-5/5.5/Kconfig
```kconfig
config SLUB_TEST
tristate "Test slub"
default m
help
   Allocate memory from slub.
```

## chapter-6/6.2/Kconfig
```kconfig
config PGTABLE_WALK
tristate "Kernel page table walk"
default m
help
   Kernel page table walk.
```
